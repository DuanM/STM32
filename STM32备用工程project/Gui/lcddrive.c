/****************************************************************************************
* 文件名：LCDDRIVE.C
* 功能：
* 
* 说明：
* 硬件连接：
****************************************************************************************/
#include "config.h"
/***********************************************************************
* 名称：LCD_Initialize()
* 功能：LCM初始化，将LCM初始化为纯图形模式，显示起始地址为0x0000，。
* 入口参数：无
* 出口参数：无
* 说明：函数会设置LCM数据总线为输出方式
***********************************************************************/
void  LCD_Initialize(void)
{ 
	LCD_Init();
}


/***********************************************************************
* 名称：LCD_FillAll()
* 功能：LCD填充。以图形方式进行填充，起始地址为0x0000。
* 入口参数：dat		要填充的数据
* 出口参数：无
***********************************************************************/
void  LCD_FillAll(uint16 dat)
{  
	LCD_Clear(dat);
}
/****************************************************************************
* 名称：GUI_FillSCR()
* 功能：全屏填充。直接使用数据填充显示缓冲区。
* 入口参数：dat		填充的数据(对于黑白色LCM，为0的点灭，为1的点显示)
* 出口参数：无
****************************************************************************/
void  GUI_FillSCR(uint16 dat)
{  
   /* 填充LCM */
   LCD_FillAll(dat);
}

/****************************************************************************
* 名称：GUI_ClearSCR()
* 功能：清屏。
* 入口参数：无
* 出口参数：无
* 说明：用户根据LCM的实际情况编写此函数。
****************************************************************************/
void  GUI_ClearSCR(void)
{  
	GUI_FillSCR(0x00);
}
/****************************************************************************
* 名称：GUI_Initialize()
* 功能：初始化GUI，包括初始化显示缓冲区，初始化LCM并清屏。
* 入口参数：无
* 出口参数：无
****************************************************************************/
void  GUI_Initialize(void)
{  
	LCD_Initialize();				// 初始化LCM模块工作模式，纯图形模式
	
	GUI_ClearSCR();		     // 初始化缓冲区为0x00，并输出屏幕(清屏)
} 

/****************************************************************************
* 名称：GUI_Point()
* 功能：在指定位置上画点。
* 入口参数：x		指定点所在列的位置
*           y		指定点所在行的位置
*           color	显示颜色(对于黑白色LCM，为0时灭，为1时显示)
* 出口参数：返回值为1时表示操作成功，为0时表示操作失败。(操作失败原因是指定地址超出有
*           效范围)
* 说明：
*  
* 
****************************************************************************/
uint8  GUI_Point(uint32 x, uint32 y, TCOLOR color)
{  
   /* 参数过滤 */
   if(x>=GUI_LCM_XMAX) return(0);
   if(y>=GUI_LCM_YMAX) return(0);
   
   LCD_DrawPoint(x,y,color);
   return(1);
}

/****************************************************************************
* 名称：GUI_ReadPoint()
* 功能：读取指定点的颜色。
* 入口参数：x		指定点所在列的位置
*           y		指定点所在行的位置
*           ret		保存颜色值的指针
* 出口参数：返回0时表示指定地址超出有效范围。
* 说明：
*      
****************************************************************************/
int  GUI_ReadPoint(uint32 x, uint32 y, TCOLOR *ret)
{  
   /* 参数过滤 */
   if(x>=GUI_LCM_XMAX) return(0);
   if(y>=GUI_LCM_YMAX) return(0);
   
   
   return(1);
}


/****************************************************************************
* 名称：GUI_HLine()
* 功能：画水平线。
* 入口参数： x0		水平线起点所在列的位置
*            y0		水平线起点所在行的位置
*            x1     水平线终点所在列的位置
*            color	显示颜色(对于黑白色LCM，为0时灭，为1时显示)
* 出口参数：无
* 说明：
****************************************************************************/
void  GUI_HLine(uint32 x0, uint32 y0, uint32 x1, uint16 color) 
{  
   uint32  bak;
   if(x0>x1) 						// 对x0、x1大小进行排列，以便画图
   {  
	  bak = x1;
      x1 = x0;
      x0 = bak;
   }   
   do
   { 
      GUI_Point(x0,y0,color);
      x0++;
   }while(x1>=x0);
}


/****************************************************************************
* 名称：GUI_RLine()
* 功能：画垂直线。
* 入口参数： x0		垂直线起点所在列的位置
*           y0		垂直线起点所在行的位置
*           y1      垂直线终点所在行的位置
*           color	显示颜色(对于黑白色LCM，为0时灭，为1时显示)
* 出口参数：无
* 说明：
****************************************************************************/
void  GUI_RLine(uint32 x0, uint32 y0, uint32 y1, uint16 color) 
{  
   uint32  bak;
   if(y0>y1) 						// 对y0、y1大小进行排列，以便画图
   {  
	  bak = y1;
      y1 = y0;
      y0 = bak;
   }
   do
   {  
	  GUI_Point(x0, y0, color);		// 逐点显示，描出垂直线
      y0++;
   }while(y1>=y0);	
}

